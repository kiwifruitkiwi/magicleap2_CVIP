## kernel/Documentation/devicetree/bindings/cvip/cvip.txt
```
CVIP Platform Driver Device Tree Bindings
-------------------------------------------

Required properties:
- compatible		: Should be "amd,cvip-plt"

Example:
	cvip_plt: cvip_plt@0 {
		status = "ok";
		compatible = "amd,cvip-plt";
	};
```

## kernel/arch/arm64/configs/ml_mero_cvip_kernel_defconfig
```kconfig
#
# Copyright (C) 2020-2021 Advanced Micro Devices, Inc. All rights reserved.
#
CONFIG_LOCALVERSION="-R54"
CONFIG_NO_HZ_IDLE=y
CONFIG_HIGH_RES_TIMERS=y
CONFIG_IRQ_TIME_ACCOUNTING=y
CONFIG_BSD_PROCESS_ACCT=y
CONFIG_BSD_PROCESS_ACCT_V3=y
CONFIG_TASKSTATS=y
CONFIG_TASK_DELAY_ACCT=y
CONFIG_TASK_XACCT=y
CONFIG_TASK_IO_ACCOUNTING=y
CONFIG_IKCONFIG=y
CONFIG_IKCONFIG_PROC=y

CONFIG_MEMCG=y
CONFIG_MEMCG_SWAP=y
CONFIG_BLK_CGROUP=y
CONFIG_CGROUP_PIDS=y
CONFIG_CGROUP_HUGETLB=y
CONFIG_CPUSETS=y
CONFIG_CGROUP_DEVICE=y
CONFIG_CGROUP_CPUACCT=y
CONFIG_CGROUP_PERF=y
CONFIG_USER_NS=y
CONFIG_SCHED_AUTOGROUP=y
CONFIG_BLK_DEV_INITRD=y
CONFIG_BLK_DEV_LOOP=y
CONFIG_KALLSYMS_ALL=y

# CONFIG_COMPAT_BRK is not set

CONFIG_JUMP_LABEL=y
CONFIG_MODULES=y
CONFIG_MODULE_UNLOAD=y
CONFIG_PCI=y
CONFIG_HOTPLUG_PCI_PCIE=y
CONFIG_HOTPLUG_PCI=y
CONFIG_PCIEPORTBUS=y

CONFIG_ARM64_VA_BITS_48=y
CONFIG_SCHED_MC=y
CONFIG_NR_CPUS=6
CONFIG_PREEMPT=y
CONFIG_MQ_IOSCHED_DEADLINE=n
CONFIG_MQ_IOSCHED_KYBER=n
# CONFIG_BALLOON_COMPACTION is not set
CONFIG_KSM=n
CONFIG_MEMORY_FAILURE=y
CONFIG_CMA=y
CONFIG_CMA_AREAS=2
CONFIG_SECCOMP=y
CONFIG_CRASH_DUMP=n

# CONFIG_ARM64_SVE is not set
# CONFIG_CORE_DUMP_DEFAULT_ELF_HEADERS is not set
CONFIG_COMPAT=y

CONFIG_WQ_POWER_EFFICIENT_DEFAULT=y
CONFIG_CPU_IDLE=y
CONFIG_ARM_PSCI_CPUIDLE=y
CONFIG_CPU_FREQ=y
CONFIG_CPU_FREQ_STAT=y
CONFIG_CPU_FREQ_GOV_POWERSAVE=y
CONFIG_CPU_FREQ_GOV_USERSPACE=y
CONFIG_CPU_FREQ_GOV_ONDEMAND=y
CONFIG_CPU_FREQ_GOV_CONSERVATIVE=y
CONFIG_CPU_FREQ_GOV_SCHEDUTIL=y
CONFIG_CPU_FREQ_DEFAULT_GOV_SCHEDUTIL=y
CONFIG_CPUFREQ_DT=y
CONFIG_ARM_BIG_LITTLE_CPUFREQ=y
CONFIG_ARM_SCPI_CPUFREQ=y
CONFIG_MERO_SCPI_PROTOCOL=y
CONFIG_ARM_SCPI_PROTOCOL=y
CONFIG_COMMON_CLK_SCPI=y

CONFIG_NET=y
CONFIG_PACKET=y
CONFIG_UNIX=y
CONFIG_INET=y
CONFIG_IP_MULTICAST=y
CONFIG_IP_PNP=y
CONFIG_IP_PNP_DHCP=y
CONFIG_IP_PNP_BOOTP=y

CONFIG_NETFILTER=y
CONFIG_BRIDGE_NETFILTER=n
CONFIG_NETFILTER_XTABLES=y
CONFIG_NF_CONNTRACK=y
CONFIG_NF_CONNTRACK_EVENTS=n
CONFIG_NETFILTER_XT_TARGET_CHECKSUM=y
CONFIG_NETFILTER_XT_TARGET_LOG=y
CONFIG_NETFILTER_XT_TARGET_CT=y
CONFIG_NETFILTER_XT_MATCH_ADDRTYPE=y
CONFIG_NETFILTER_XT_MATCH_CONNTRACK=y
CONFIG_NF_CONNTRACK_IPV4=y
CONFIG_NF_CONNTRACK_TFTP=y
CONFIG_IP_NF_IPTABLES=y
CONFIG_IP_NF_FILTER=y
CONFIG_IP_NF_TARGET_REJECT=y
CONFIG_IP_NF_NAT=y
CONFIG_IP_NF_FTP=y
CONFIG_IP_NF_IRC=y
CONFIG_IP_NF_TARGET_MASQUERADE=y
CONFIG_IP_NF_MATCH_STATE=y
CONFIG_IP_NF_MANGLE=y
CONFIG_NF_CONNTRACK_IPV6=n
CONFIG_IPV6=n
CONFIG_IP6_NF_IPTABLES=n
CONFIG_IP6_NF_FILTER=n
CONFIG_IP6_NF_TARGET_REJECT=n
CONFIG_IP6_NF_MANGLE=n
CONFIG_IP6_NF_NAT=n
CONFIG_IP6_NF_TARGET_MASQUERADE=n
CONFIG_IP_NF_TARGET_LOG=y
CONFIG_BRIDGE=y
CONFIG_BRIDGE_VLAN_FILTERING=y
CONFIG_IP_NF_MATCH_LIMIT=y

CONFIG_VLAN_8021Q=n
CONFIG_VLAN_8021Q_GVRP=n
CONFIG_VLAN_8021Q_MVRP=n
CONFIG_RFKILL=m
CONFIG_NET_9P=n
CONFIG_NET_9P_VIRTIO=n
CONFIG_UEVENT_HELPER_PATH="/sbin/hotplug"
CONFIG_DEVTMPFS=y
CONFIG_DEVTMPFS_MOUNT=y
CONFIG_DMA_CMA=y
## CONFIG_BRCMSTB_GISB_ARB=y
## CONFIG_VEXPRESS_CONFIG=y

## CONFIG_OF_OVERLAY=y

CONFIG_VIRTIO_BLK=y
# CONFIG_VEXPRESS_SYSCFG is not set

CONFIG_NETDEVICES=y
CONFIG_MACVLAN=m
CONFIG_MACVTAP=m
CONFIG_TUN=y
CONFIG_VETH=m
CONFIG_VIRTIO_NET=y

## CONFIG_MVMDIO=y

## CONFIG_MDIO_BITBANG=y

CONFIG_MDIO_BUS_MUX_MMIOREG=y
CONFIG_USB_PEGASUS=m
CONFIG_USB_RTL8150=m
CONFIG_USB_RTL8152=m
CONFIG_USB_USBNET=m
CONFIG_USB_NET_DM9601=m
CONFIG_USB_NET_SR9800=m
CONFIG_USB_NET_SMSC75XX=m
CONFIG_USB_NET_SMSC95XX=m
CONFIG_USB_NET_PLUSB=m
CONFIG_USB_NET_MCS7830=m
CONFIG_INPUT_POLLDEV=y
CONFIG_INPUT_EVDEV=y
CONFIG_KEYBOARD_GPIO=y
CONFIG_INPUT_MISC=y

# CONFIG_SERIO_SERPORT is not set
CONFIG_LEGACY_PTY_COUNT=16
CONFIG_SERIAL_8250=y
CONFIG_SERIAL_8250_CONSOLE=y
CONFIG_SERIAL_8250_EXTENDED=y
CONFIG_SERIAL_8250_SHARE_IRQ=y
CONFIG_SERIAL_8250_DW=y
CONFIG_SERIAL_OF_PLATFORM=y
CONFIG_SERIAL_DEV_BUS=y
CONFIG_VIRTIO_CONSOLE=y

#
# I2C support
#
CONFIG_I2C=y
CONFIG_I2C_BOARDINFO=y
CONFIG_I2C_COMPAT=y
CONFIG_I2C_CHARDEV=y
CONFIG_I2C_HELPER_AUTO=y
CONFIG_I2C_DESIGNWARE_PLATFORM=y

CONFIG_PINCTRL=y
CONFIG_PINCTRL_SINGLE=y
CONFIG_THERMAL=y
CONFIG_THERMAL_GOV_POWER_ALLOCATOR=y
CONFIG_CPU_THERMAL=y
CONFIG_THERMAL_EMULATION=y

CONFIG_SCSI=n
CONFIG_SCSI_DMA=n
CONFIG_SCSI_LOWLEVEL=n
CONFIG_SCSI_SAS_ATA=n
CONFIG_SCSI_HISI_SAS=n
CONFIG_SCSI_HISI_SAS_PCI=n
CONFIG_SCSI_MPT3SAS=n
CONFIG_SCSI_UFSHCD=n
CONFIG_SCSI_UFSHCD_PLATFORM=n
CONFIG_SCSI_UFS_QCOM=n
CONFIG_SCSI_UFS_HISI=n
CONFIG_ATA=n
CONFIG_SATA_AHCI=n
CONFIG_SATA_AHCI_PLATFORM=n
CONFIG_AHCI_CEVA=n
CONFIG_AHCI_MVEBU=n
CONFIG_AHCI_XGENE=n
CONFIG_AHCI_QORIQ=n
CONFIG_SATA_SIL24=n
CONFIG_SATA_RCAR=n
CONFIG_PATA_PLATFORM=n
CONFIG_PATA_OF_PLATFORM=n

CONFIG_USB=y
CONFIG_USB_OTG=y
CONFIG_USB_STORAGE=y
CONFIG_USB_DWC3=y
CONFIG_USB_DWC3_ULPI=y
#CONFIG_USB_DWC3_GADGET=y
CONFIG_USB_DWC3_DUAL_ROLE=y
CONFIG_USB_DWC3_PCI=y
CONFIG_USB_SERIAL=y
CONFIG_NOP_USB_XCEIV=y
CONFIG_USB_ULPI=y
CONFIG_USB_GADGET=y
CONFIG_USB_MASS_STORAGE=n
CONFIG_USB_SNP_UDC_PLAT=y
CONFIG_USB_ULPI_BUS=y
CONFIG_USB_NET_DRIVERS=y
CONFIG_USB_ETH_RNDIS=y
CONFIG_USB_ROLE_SWITCH=y

CONFIG_RTC_CLASS=y
CONFIG_RTC_DRV_CVIP=y

CONFIG_DMADEVICES=y
## CONFIG_BCM_SBA_RAID=y
CONFIG_PL330_DMA=y
CONFIG_DMATEST=y
## CONFIG_SYNC_FILE=y
CONFIG_VFIO=y
CONFIG_VFIO_PCI=y
CONFIG_VIRTIO_PCI=y
CONFIG_VIRTIO_BALLOON=y
CONFIG_VIRTIO_MMIO=y
CONFIG_COMMON_CLK_VERSATILE=y
# CONFIG_COMMON_CLK_XGENE is not set
# CONFIG_FSL_ERRATUM_A008585 is not set
# CONFIG_HISILICON_ERRATUM_161010101 is not set
# CONFIG_ARM64_ERRATUM_858921 is not set
CONFIG_MAILBOX=y
CONFIG_PL320_IPC=y
CONFIG_CVIP_IPC=y
CONFIG_MERO_MBOX=y
CONFIG_MERO_MBOX_DEV=y
CONFIG_IPC_XPORT=y
# CONFIG_ARM_MHU is not set
# CONFIG_PLATFORM_MHU is not set
# Kernel Performance Events And Counters
CONFIG_PERF_EVENTS=y
# end of Kernel Performance Events And Counters
CONFIG_PROFILING=y
CONFIG_HW_PERF_EVENTS=y
CONFIG_HAVE_HW_BREAKPOINT=y
CONFIG_MODULES_TREE_LOOKUP=y
# Performance monitor support
CONFIG_ARM_PMU=y
# end of Performance monitor support
CONFIG_ARM_SMMU_V3=y
CONFIG_ARM_SMMU_V3_PMU=y
CONFIG_EXTCON_USB_GPIO=y
CONFIG_MEMORY=y

CONFIG_TEE=y
CONFIG_OPTEE=y
CONFIG_AMDTEE=y
CONFIG_AMDTEE_CCP_AES=n
CONFIG_CRYPTO_DEV_CCP=y
CONFIG_CRYPTO_DEV_CCP_DD=y

# CONFIG_DMIID is not set
CONFIG_EFI_CAPSULE_LOADER=y
CONFIG_EXT2_FS=y
CONFIG_EXT3_FS=y
CONFIG_EXT4_FS_POSIX_ACL=y
CONFIG_FANOTIFY=y
CONFIG_FANOTIFY_ACCESS_PERMISSIONS=y
CONFIG_QUOTA=n
CONFIG_AUTOFS4_FS=y
CONFIG_FUSE_FS=m
CONFIG_CUSE=m
CONFIG_OVERLAY_FS=m
CONFIG_FAT_FS=n
CONFIG_VFAT_FS=n
CONFIG_TMPFS=y
CONFIG_TMPFS_POSIX_ACL=y
CONFIG_TMPFS_XATTR=y
CONFIG_HUGETLBFS=y
CONFIG_CONFIGFS_FS=y
CONFIG_SQUASHFS=n
CONFIG_PSTORE=y
CONFIG_PSTORE_DEFLATE_COMPRESS=n
CONFIG_PSTORE_CONSOLE=y
CONFIG_PSTORE_PMSG=y
CONFIG_PSTORE_FTRACE=y
CONFIG_PSTORE_RAM=y
CONFIG_NFS_FS=y
CONFIG_NFS_V4=y
CONFIG_NFS_V4_1=y
CONFIG_NFS_V4_2=y
CONFIG_ROOT_NFS=y
CONFIG_9P_FS=n
CONFIG_NLS_CODEPAGE_437=y
CONFIG_NLS_ISO8859_1=y

CONFIG_PRINTK_TIME=y
CONFIG_DYNAMIC_DEBUG=y

CONFIG_DEBUG_INFO=y

CONFIG_DEBUG_FS=y
CONFIG_MAGIC_SYSRQ=y
CONFIG_DEBUG_KERNEL=y

# CONFIG_SCHED_DEBUG is not set
# CONFIG_DEBUG_PREEMPT is not set
# CONFIG_RUNTIME_TESTING_MENU is not set
# CONFIG_STRICT_DEVMEM is not set
CONFIG_SECURITY=y
##CONFIG_CRYPTO_RSA=y
## CONFIG_CRYPTO_ECDH=y
# CONFIG_CRYPTO_MANAGER_DISABLE_TESTS is not set
## CONFIG_CRYPTO_CCM=y
## CONFIG_CRYPTO_GCM=y
# CONFIG_CRYPTO_ECHAINIV is not set
## CONFIG_CRYPTO_ECB=y
## CONFIG_CRYPTO_CMAC=y
## CONFIG_CRYPTO_SHA512=y
## CONFIG_CRYPTO_ARC4=y
## CONFIG_CRYPTO_DES=y
CONFIG_CRYPTO_HW=y
## CONFIG_ASYMMETRIC_KEY_TYPE=y
## CONFIG_ASYMMETRIC_PUBLIC_KEY_SUBTYPE=y
## CONFIG_X509_CERTIFICATE_PARSER=y
## CONFIG_PKCS7_MESSAGE_PARSER=y
## CONFIG_SYSTEM_TRUSTED_KEYRING=y
CONFIG_ARM64_CRYPTO=y

CONFIG_CRYPTO_SHA1_ARM64_CE=y
CONFIG_CRYPTO_SHA2_ARM64_CE=y
CONFIG_CRYPTO_GHASH_ARM64_CE=y
CONFIG_CRYPTO_CRCT10DIF_ARM64_CE=m
CONFIG_CRYPTO_CRC32_ARM64_CE=m
CONFIG_CRYPTO_AES_ARM64_CE_CCM=y
CONFIG_CRYPTO_AES_ARM64_CE_BLK=y
CONFIG_CRYPTO_CHACHA20_NEON=m
CONFIG_CRYPTO_AES_ARM64_BS=m
CONFIG_CRYPTO_SHA512_ARM64_CE=m
CONFIG_CRYPTO_SHA3_ARM64=m
CONFIG_CRYPTO_SM3_ARM64_CE=m

CONFIG_ARCH_MERO_CVIP=y
CONFIG_GDB_SCRIPTS=y

CONFIG_KEXEC=y

CONFIG_HZ_8000=y
CONFIG_HZ=8000
CONFIG_EFI=n

CONFIG_WATCHDOG=y
CONFIG_MERO_WATCHDOG=y
CONFIG_WATCHDOG_HANDLE_BOOT_ENABLED=y
CONFIG_WATCHDOG_OPEN_TIMEOUT=0

CONFIG_MERO_DSP_MANAGER=y

CONFIG_ANDROID=y
CONFIG_STAGING=y
CONFIG_ION=y
CONFIG_ION_SYSTEM_HEAP=y
CONFIG_ION_CARVEOUT_HEAP=y
CONFIG_ION_CHUNK_HEAP=y
CONFIG_ION_MERO=y
CONFIG_ION_CARVEOUT_HEAP_PAGE_ZERO=n
CONFIG_ION_TEST=y

CONFIG_ANDROID_BINDER_IPC=y
CONFIG_ANDROID_BINDER_DEVICES="binder,hwbinder,vndbinder"
CONFIG_ANDROID_BINDER_IPC_SELFTEST=y

CONFIG_AUDIT=y
CONFIG_AUDITSYSCALL=y
CONFIG_NETWORK_SECMARK=y
CONFIG_SECURITY_NETWORK=y
CONFIG_LSM_MMAP_MIN_ADDR=32768
CONFIG_SECURITY_SELINUX=y
CONFIG_SECURITY_SELINUX_DEVELOP=y
CONFIG_SECURITY_SELINUX_AVC_STATS=y
CONFIG_SECURITY_SELINUX_CHECKREQPROT_VALUE=0
CONFIG_INTEGRITY_AUDIT=y
CONFIG_AUDIT_GENERIC=y
CONFIG_AUDIT_COMPAT_GENERIC=y

CONFIG_SYSVIPC=y
CONFIG_POSIX_MQUEUE=y

CONFIG_CONNECTOR=y

CONFIG_CVIP_SYS_CACHE=y

CONFIG_PCI_CVIP=y
CONFIG_AMD_CVIP_MSI=y

CONFIG_CVIP_LOGGER=y

#
# NVME Support
#
CONFIG_NVME_CORE=n
CONFIG_BLK_DEV_NVME=n
CONFIG_NVME_MULTIPATH=n
CONFIG_NVME_FABRICS=n
CONFIG_NVME_FC=n
CONFIG_NVME_TARGET=n
CONFIG_NVME_TARGET_LOOP=n
CONFIG_NVME_TARGET_FC=n
CONFIG_NVME_TARGET_FCLOOP=n

CONFIG_PM_DEBUG=y
CONFIG_PM_WAKELOCKS=y

#
# MERO SMU Support
#
CONFIG_MERO_SMU=y

#
# Hardware Monitor sensors
#
CONFIG_HWMON=y
CONFIG_SENSORS_MERO=y

CONFIG_FUNCTION_TRACER=y
CONFIG_FUNCTION_GRAPH_TRACER=y
CONFIG_STACK_TRACER=y
CONFIG_DYNAMIC_FTRACE=y

# SPI support
CONFIG_SPI=y
CONFIG_SPI_AMD=y
CONFIG_SPI_SPIDEV=y

CONFIG_RECOVERY_DUMP=y

CONFIG_PINMUX=y
CONFIG_PINCONF=y
CONFIG_PINCTRL_CVIP=y
CONFIG_E1000E=n
CONFIG_NO_ARCHTIMER_SYSTEM_RESTART=y

# GPIO LIB support
CONFIG_GPIOLIB=y
CONFIG_OF_GPIO=y
CONFIG_GPIO_SYSFS=y
CONFIG_GPIO_GENERIC_PLATFORM=y

CONFIG_XPORT_TEST=y

CONFIG_PTP_1588_CLOCK=n
CONFIG_PPS=n
CONFIG_INPUT_MOUSE=n
CONFIG_INPUT_MOUSEDEV=n
CONFIG_INPUT_KEYBOARD=n
CONFIG_HID_APPLE=n
CONFIG_HID_A4TECH=n
CONFIG_HID_BELKIN=n
CONFIG_HID_CHERRY=n
CONFIG_HID_CYPRESS=n
CONFIG_HID_EZKEY=n
CONFIG_HID_KENSINGTON=n
CONFIG_HID_ITE=n
CONFIG_HID_LOGITECH=n
CONFIG_HID_MICROSOFT=n
CONFIG_HID_MONTEREY=n
CONFIG_HID_REDRAGON=n
CONFIG_SERIAL_8250_EXAR=n
CONFIG_SERIAL_8250_PCI=n

# Stm console
CONFIG_STM_SOURCE_CONSOLE=y
# Coresight
CONFIG_CORESIGHT=y
CONFIG_CORESIGHT_LINK_AND_SINK_TMC=y
CONFIG_CORESIGHT_SINK_TPIU=y
CONFIG_CORESIGHT_SINK_ETBV10=y
CONFIG_CORESIGHT_SOURCE_ETM4X=y
CONFIG_CORESIGHT_STM=y
CONFIG_CORESIGHT_CPU_DEBUG=y

#########################################################
# (C) Copyright 2020-2021 Magic Leap, Inc. (COMPANY)
#########################################################

# CVIP USB Ethernet Support
CONFIG_USB_U_ETHER=y
CONFIG_USB_F_ECM=y
CONFIG_USB_F_SUBSET=y
CONFIG_USB_F_RNDIS=y
CONFIG_USB_ETH=y

# For hydra/xcmp debug
CONFIG_TRACEPOINTS=y

# IPC VCAM ISP support
CONFIG_ISP_SENSOR_SIM=n
CONFIG_IPC_VCAM_ISP=y

# NDB support
CONFIG_BLK_DEV_NBD=y

# IIO support for imu driver
CONFIG_IIO=y
CONFIG_IIO_BUFFER=y
CONFIG_IIO_KFIFO_BUF=y
CONFIG_IIO_TRIGGER=y
CONFIG_IIO_TRIGGERED_BUFFER=y
CONFIG_IIO_CONSUMERS_PER_TRIGGER=2

# GDB support for mmapped ION buffers
CONFIG_ARM64_GDB_ACCESS=y

# Enable to help lower boot time
CONFIG_DEFERRED_STRUCT_PAGE_INIT=y

CONFIG_ASYNC_POPULATE_ROOTFS=y

# Enable CVIP platform driver
CONFIG_CVIP_PLT=y

#Enable CVIP hardware indicator flag
CONFIG_ML_CVIP_HARDWARE=y

# Enable ext4 security for nbd mounts
CONFIG_EXT4_FS_SECURITY=y

# Installs dm-verity driver
CONFIG_MD=y
CONFIG_BLK_DEV_DM_BUILTIN=y
CONFIG_BLK_DEV_DM=y
CONFIG_DM_BUFIO=y
CONFIG_DM_VERITY=y
CONFIG_PNFS_BLOCK=y

# Enable dev/mem
CONFIG_DEVMEM=y

#Enable mero_smmu kernel module
CONFIG_ML_MERO_SMMU=y

#Enable dsp core kernel module
CONFIG_ML_DSP_CORE=y

# cvip only kernel modules
CONFIG_ML_CDP=y
CONFIG_ML_DCPRS=y
CONFIG_ML_INV_MPU=y
```
